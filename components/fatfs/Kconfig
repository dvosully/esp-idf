## components/fatfs/Kconfig
```kconfig
menu "FAT Filesystem support"

    config FATFS_SET_ADVANCED_OPTIONS
        bool "Set Advanced FatFS Options"
        default n
        help
            This option allows the user to adjust advanced FatFS configuration options.
            Warning: Some of these options may break the VFS file interface.


    config FATFS_READONLY
        bool "Remove writing API functions"
        depends on FATFS_SET_ADVANCED_OPTIONS
        default n
        help
            This option affects FATFS configuration value _FS_READONLY.

            If this option is set, _FS_READONLY is 1.
            Read-only configuration removes writing API functions, f_write, f_sync,
            f_unlink, f_mkdir, f_chmod, f_rename, f_truncate, f_getfree and optional
            writing functions as well.


    choice FATFS_CHOOSE_MINIMIZE
        prompt "Remove some basic API functions writing API functions"
        depends on FATFS_SET_ADVANCED_OPTIONS
        default FATFS_MINIMIZE_0
        help
            This option affects FATFS configuration value _FS_MINIMIZE.
            This option defines minimization level to remove some basic API functions
            as follows:

            0: All basic API functions are available
            1: f_stat, f_getfree, f_unlink, f_mkdir, f_chmod, f_utime, f_truncate and
            f_rename function are removed
            2: f_opendir, f_readdir and f_closedir function are removed in addition to 1
            3: f_lseek function is removed in addition to 2

        config FATFS_MINIMIZE_0
            bool "0 All basic API functions are available"
        config FATFS_MINIMIZE_1
            bool "1 Remove f_stat, f_getfree, f_unlink, f_mkdir, f_chmod, f_utime, f_truncate and f_rename"
        config FATFS_MINIMIZE_2
            bool "2 Also remove f_opendir, f_readdir and f_closedir"
        config FATFS_MINIMIZE_3
            bool "3 Also remove f_lseek"

    endchoice

    config FATFS_MINIMIZE
        int
        default 0 if FATFS_MINIMIZE_0
        default 1 if FATFS_MINIMIZE_1
        default 2 if FATFS_MINIMIZE_2
        default 3 if FATFS_MINIMIZE_3
        default 0


    config FATFS_USE_FIND
        bool "Enable filtered directory read functions, f_findfirst and f_findnext"
        depends on FATFS_SET_ADVANCED_OPTIONS && (FATFS_MINIMIZE <= 1)
        default n
        help
            Disable or Enable filtered directory read functions, f_findfirst and f_findnext
            Also _FS_MINIMIZE needs to be 0 or 1


    config FATFS_USE_MKFS
        bool "Enable f_mkfs function"
        depends on FATFS_SET_ADVANCED_OPTIONS
        default y


    config FATFS_USE_EXPAND
        bool "Enable f_expand function"
        depends on FATFS_SET_ADVANCED_OPTIONS
        default n


    config FATFS_USE_CHMOD
        bool "Enable metadata control functions f_chmod and f_utime."
        depends on FATFS_SET_ADVANCED_OPTIONS && !FATFS_READONLY
        default y
        help
            Disable or Enable fast seek function to enable accelerated mode for f_lseek,
            f_read and f_write function.


    config FATFS_USE_LABEL
        bool "Enable API functions for volume label f_getlabel and f_setlabel"
        depends on FATFS_SET_ADVANCED_OPTIONS
        default n


    config FATFS_USE_FORWARD
        bool "Enable f_forward function"
        depends on FATFS_SET_ADVANCED_OPTIONS
        default n


    choice FATFS_CHOOSE_USE_STRFUNC
        prompt "Enable string file functions fgets, fputc, fputs and fprintf"
        depends on FATFS_SET_ADVANCED_OPTIONS
        default FATFS_USE_STRFUNC_0
        help
            This option switches string functions f_gets, f_putc, f_puts and f_printf.
            These functions are equivalents of regular string stream I/O functions in POSIX.
            If sprintf is available and code conversion is not needed, f_write with sprintf
            will be efficient in code size and performance rather than f_printf.
            When enable this feature, stdarg.h is included in ff.c

            0: Disable string functions
            1: Enable string functions without LF-CRLF conversion
            2: Enable string functions with LF-CRLF conversion

        config FATFS_USE_STRFUNC_0
            bool "0 Disable string functions"
        config FATFS_USE_STRFUNC_1
            bool "1 Enable string functions without LF-CRLF conversion"
        config FATFS_USE_STRFUNC_2
            bool "2 Enable string functions with LF-CRLF conversion"
    endchoice

    config FATFS_USE_STRFUNC
        int
        default 0 if FATFS_USE_STRFUNC_0
        default 1 if FATFS_USE_STRFUNC_1
        default 2 if FATFS_USE_STRFUNC_2
        default 0


    config FATFS_PRINT_LLI
        bool "Enable support for long long integer argument in f_printf"
        depends on FATFS_SET_ADVANCED_OPTIONS && (FATFS_USE_STRFUNC > 0)
        default n
        help
            This option switches support for long long integer argument in f_printf.
            When enable this feature, C standard needs to be C99 or later.


    choice FATFS_CHOOSE_PRINT_FLOAT
        prompt "Enable support for floating point argument in f_printf"
        depends on FATFS_SET_ADVANCED_OPTIONS && (FATFS_USE_STRFUNC > 0)
        default FATFS_PRINT_FLOAT_1
        help
            This option switches support for floating point argument in f_printf.
            When enable this feature, C standard needs to be C99 or later and
            math.h is included in ff.c

            0: Disable floating point arguments
            1: Enable floating point arguments in type 'f', 'e' and 'E'.
            2: Enable it with decimal separator ',' instead of '.'

        config FATFS_PRINT_FLOAT_0
            bool "0 Disable floating point arguments"
        config FATFS_PRINT_FLOAT_1
            bool "1 Enable floating point arguments in type 'f', 'e' and 'E'"
        config FATFS_PRINT_FLOAT_2
            bool "2 Enable floating point with decimal separator ',' instead of '.'"
    endchoice

    config FATFS_PRINT_FLOAT
        int
        default 0 if FATFS_PRINT_FLOAT_0
        default 1 if FATFS_PRINT_FLOAT_1
        default 2 if FATFS_PRINT_FLOAT_2
        default 1


    config FATFS_STRF_ENCODE
        int "Convert the f_printf character encoding to selected"
        depends on FATFS_SET_ADVANCED_OPTIONS && (FATFS_USE_STRFUNC > 0)
        default 0
        range 0 3
        help
            When character encoding on the API is Unicode (FF_LFN_UNICODE >= 1),
            string I/O functions enabled by FF_USE_STRFUNC convert the character
            encoding in it. This option defines the assumption of character
            encoding _on the file_ to be read/written via those functions.
            When LFN is not enabled or FF_LFN_UNICODE == 0, the string functions
            will work without any code conversion and this option has no effect.


    config FATFS_VOLUME_COUNT
        int "Number of volumes"
        default 2
        range 1 10
        help
            Number of volumes (logical drives) to use.

    choice FATFS_LONG_FILENAMES
        prompt "Long filename support"
        default FATFS_LFN_NONE
        help
            Support long filenames in FAT. Long filename data increases
            memory usage. FATFS can be configured to store the buffer for
            long filename data in stack or heap.

        config FATFS_LFN_NONE
            bool "No long filenames"
        config FATFS_LFN_HEAP
            bool "Long filename buffer in heap"
        config FATFS_LFN_STACK
            bool "Long filename buffer on stack"
    endchoice
    choice FATFS_SECTOR_SIZE
        prompt "Sector size"
        default FATFS_SECTOR_4096
        help
            Specify the size of the sector in bytes for FATFS partition generator.

        config FATFS_SECTOR_512
            bool "512"
        config FATFS_SECTOR_4096
            bool "4096"
    endchoice
    choice FATFS_CHOOSE_CODEPAGE
        prompt "OEM Code Page"
        default FATFS_CODEPAGE_437
        help
            OEM code page used for file name encodings.

            If "Dynamic" is selected, code page can be chosen at runtime using
            f_setcp function. Note that choosing this option will increase
            application size by ~480kB.

        config FATFS_CODEPAGE_DYNAMIC
            bool "Dynamic (all code pages supported)"
        config FATFS_CODEPAGE_437
            bool "US (CP437)"
        config FATFS_CODEPAGE_720
            bool "Arabic (CP720)"
        config FATFS_CODEPAGE_737
            bool "Greek (CP737)"
        config FATFS_CODEPAGE_771
            bool "KBL (CP771)"
        config FATFS_CODEPAGE_775
            bool "Baltic (CP775)"
        config FATFS_CODEPAGE_850
            bool "Latin 1 (CP850)"
        config FATFS_CODEPAGE_852
            bool "Latin 2 (CP852)"
        config FATFS_CODEPAGE_855
            bool "Cyrillic (CP855)"
        config FATFS_CODEPAGE_857
            bool "Turkish (CP857)"
        config FATFS_CODEPAGE_860
            bool "Portuguese (CP860)"
        config FATFS_CODEPAGE_861
            bool "Icelandic (CP861)"
        config FATFS_CODEPAGE_862
            bool "Hebrew (CP862)"
        config FATFS_CODEPAGE_863
            bool "Canadian French (CP863)"
        config FATFS_CODEPAGE_864
            bool "Arabic (CP864)"
        config FATFS_CODEPAGE_865
            bool "Nordic (CP865)"
        config FATFS_CODEPAGE_866
            bool "Russian (CP866)"
        config FATFS_CODEPAGE_869
            bool "Greek 2 (CP869)"
        config FATFS_CODEPAGE_932
            bool "Japanese (DBCS) (CP932)"
        config FATFS_CODEPAGE_936
            bool "Simplified Chinese (DBCS) (CP936)"
        config FATFS_CODEPAGE_949
            bool "Korean (DBCS) (CP949)"
        config FATFS_CODEPAGE_950
            bool "Traditional Chinese (DBCS) (CP950)"

    endchoice
    config FATFS_CODEPAGE
        int
        default 0 if FATFS_CODEPAGE_DYNAMIC
        default 437 if FATFS_CODEPAGE_437
        default 720 if FATFS_CODEPAGE_720
        default 737 if FATFS_CODEPAGE_737
        default 771 if FATFS_CODEPAGE_771
        default 775 if FATFS_CODEPAGE_775
        default 850 if FATFS_CODEPAGE_850
        default 852 if FATFS_CODEPAGE_852
        default 855 if FATFS_CODEPAGE_855
        default 857 if FATFS_CODEPAGE_857
        default 860 if FATFS_CODEPAGE_860
        default 861 if FATFS_CODEPAGE_861
        default 862 if FATFS_CODEPAGE_862
        default 863 if FATFS_CODEPAGE_863
        default 864 if FATFS_CODEPAGE_864
        default 865 if FATFS_CODEPAGE_865
        default 866 if FATFS_CODEPAGE_866
        default 869 if FATFS_CODEPAGE_869
        default 932 if FATFS_CODEPAGE_932
        default 936 if FATFS_CODEPAGE_936
        default 949 if FATFS_CODEPAGE_949
        default 950 if FATFS_CODEPAGE_950
        default 437

    config FATFS_MAX_LFN
        int "Max long filename length"
        depends on !FATFS_LFN_NONE
        default 255
        range 12 255
        help
            Maximum long filename length. Can be reduced to save RAM.

    choice FATFS_API_ENCODING
        prompt "API character encoding"
        depends on !FATFS_LFN_NONE
        default FATFS_API_ENCODING_ANSI_OEM
        help
            Choose encoding for character and string arguments/returns when using
            FATFS APIs. The encoding of arguments will usually depend on text
            editor settings.

        config FATFS_API_ENCODING_ANSI_OEM
            bool "API uses ANSI/OEM encoding"
        config FATFS_API_ENCODING_UTF_8
            bool "API uses UTF-8 encoding"
    endchoice

    choice FATFS_CHOOSE_VOLUME_ID
        prompt "Support String Volume ID"
        depends on FATFS_SET_ADVANCED_OPTIONS
        default FATFS_VOLUME_ID_0
        help
            This option switches the support for string volume ID. When arbitrary string
            for the volume ID is enabled for the drive prefix, also pre-defined strings
            by FF_VOLUME_STRS or user defined strings can be used as drive prefix in the
            path name. Numeric drive number is always valid regardless of this option,
            and also either format of drive prefix can be enabled by this option.

        config FATFS_VOLUME_ID_0
            bool "0 Only DOS style numeric prefix supported - 1:/filename"
        config FATFS_VOLUME_ID_1
            bool "1 Add DOS style string prefix supported - sdcard:/filename"
        config FATFS_VOLUME_ID_2
            bool "2 Add Unix style string prefix supported - /sdcard/filename"
    endchoice

    config FATFS_VOLUME_ID
        int
        default 0 if FATFS_VOLUME_ID_0
        default 1 if FATFS_VOLUME_ID_1
        default 2 if FATFS_VOLUME_ID_2
        default 0


    config FATFS_MULTI_PARTITION
        bool "Enable multi-partition function"
        depends on FATFS_SET_ADVANCED_OPTIONS
        default y
        help
            Disable (0) or Enable (1). This option switches multi-partition function.
            By default (0), each logical drive number is bound to the same physical
            drive number and only a volume in the physical drive is mounted.
            When enabled, each logical drive is bound to the partition on the physical
            drive listed in the user defined partition resolution table VolToPart[].
            Also f_fdisk funciton will be available.


    config FATFS_EXFAT
        bool "Enable exFAT support. Requires C99"
        depends on FATFS_SET_ADVANCED_OPTIONS
        default n
        help
            This option switches support for exFAT filesystem in addition to the
            FAT/FAT32 filesystem, Enabled (1) or Disabled (0). To enable exFAT,
            also LFN must be enabled and configureing FF_LFN_UNICODE >= 1 and
            FF_MAX_LFN == 255 is recommended for full-featured exFAT function.
            Note that enabling exFAT discards ANSI C (C89) compatibility and
            wants C99 because of need for 64-bit integer type.


    config FATFS_NORTC
        bool "Disable RTC timestamp metadata"
        depends on FATFS_SET_ADVANCED_OPTIONS && !FATFS_READONLY
        default n
        help
            Use RTC (0) or Do not use RTC (1). This option controls timestamp feature.
            If the system does not have an RTC or valid timestamp is not needed, set
            FF_FS_NORTC to 1 to disable the timestamp function. Every objects modified
            by FatFs will have a constant timestamp defined by FF_NORTC_MON, FF_NORTC_MDAY
            and FF_NORTC_YEAR. To use the timestamp featuer, set FF_FS_NORTC == 0 and add
            get_fattime function to the project to get current time from the RTC.
            This option has no effect in read-only configuration.

    config FATFS_NORTC_MDAY
        int "Day to be used as time in no RTC system"
        depends on FATFS_NORTC
        default 1
        range 1 31

    config FATFS_NORTC_MON
        int "Month to be used as time in no RTC system"
        depends on FATFS_NORTC
        default 1
        range 1 12

    config FATFS_NORTC_YEAR
        int "Day to be used as time in no RTC system"
        depends on FATFS_NORTC
        default 2018


    choice FATFS_CHOOSE_NOFSINFO
        prompt "Configure Usage of FSINFO"
        depends on FATFS_SET_ADVANCED_OPTIONS
        default FATFS_NOFSINFO_0
        help
            0 to 3. If you need to know correct free space on the FAT32 volume,
            set bit 0 of this option, and f_getfree function at first time after
            the volume mounted will force a full FAT scan.
            Bit 1 controls the use of last allocated cluster number for new allocation.

            bit0=0: Use free cluster count in the FSINFO if available
            bit0=1: Do not trust free cluster count in the FSINFO.
            bit1=0: Use last allocated cluster number in the FSINFO to find a free cluster if available
            bit1=1:Do not trust last allocated cluster number in the FSINFO

        config FATFS_NOFSINFO_0
            bool "0 Use FSINFO free cluster count and last allocated cluster"
        config FATFS_NOFSINFO_1
            bool "1 Do not trust FSINFO free cluster count, do full FAT scan. Use FSINFO last allocated cluster"
        config FATFS_NOFSINFO_2
            bool "2 Use FSINFO free cluster count. Do not trust FSINFO last allocated cluster"
        config FATFS_NOFSINFO_3
            bool "3 Do not trust FSINFO free cluster count OR last allocated cluster. Do full FAT scan."
    endchoice

    config FATFS_NOFSINFO
        int
        default 0 if FATFS_NOFSINFO_0
        default 1 if FATFS_NOFSINFO_1
        default 2 if FATFS_NOFSINFO_2
        default 3 if FATFS_NOFSINFO_3
        default 0


    config FATFS_FS_LOCK
        int "Number of simultaneously open files protected by lock function"
        default 0
        range 0 65535
        help
            This option sets the FATFS configuration value _FS_LOCK.
            The option _FS_LOCK switches file lock function to control duplicated file open
            and illegal operation to open objects.

            * 0: Disable file lock function. To avoid volume corruption, application
            should avoid illegal open, remove and rename to the open objects.

            * >0: Enable file lock function. The value defines how many files/sub-directories
            can be opened simultaneously under file lock control.

            Note that the file lock control is independent of re-entrancy.

    config FATFS_TIMEOUT_MS
        int "Timeout for acquiring a file lock, ms"
        default 10000
        help
            This option sets FATFS configuration value _FS_TIMEOUT, scaled to milliseconds.
            Sets the number of milliseconds FATFS will wait to acquire a mutex when
            operating on an open file. For example, if one task is performing a lengthy
            operation, another task will wait for the first task to release the lock,
            and time out after amount of time set by this option.


    config FATFS_PER_FILE_CACHE
        bool "Use separate cache for each file"
        default y
        help
            This option affects FATFS configuration value _FS_TINY.

            If this option is set, _FS_TINY is 0, and each open file has its own cache,
            size of the cache is equal to the _MAX_SS variable (512 or 4096 bytes).
            This option uses more RAM if more than 1 file is open, but needs less reads
            and writes to the storage for some operations.

            If this option is not set, _FS_TINY is 1, and single cache is used for
            all open files, size is also equal to _MAX_SS variable. This reduces the
            amount of heap used when multiple files are open, but increases the number
            of read and write operations which FATFS needs to make.


    config FATFS_ALLOC_PREFER_EXTRAM
        bool "Prefer external RAM when allocating FATFS buffers"
        default y
        depends on SPIRAM_USE_CAPS_ALLOC || SPIRAM_USE_MALLOC
        help
            When the option is enabled, internal buffers used by FATFS will be allocated
            from external RAM. If the allocation from external RAM fails, the buffer will
            be allocated from the internal RAM.
            Disable this option if optimizing for performance. Enable this option if
            optimizing for internal memory size.


    config FATFS_USE_FASTSEEK
        bool "Enable fast seek algorithm when using lseek function through VFS FAT"
        default n
        help
            The fast seek feature enables fast backward/long seek operations without
            FAT access by using an in-memory CLMT (cluster link map table).
            Please note, fast-seek is only allowed for read-mode files, if a
            file is opened in write-mode, the seek mechanism will automatically fallback
            to the default implementation.


    config FATFS_FAST_SEEK_BUFFER_SIZE
        int "Fast seek CLMT buffer size"
        default 64
        depends on FATFS_USE_FASTSEEK
        help
            If fast seek algorithm is enabled, this defines the size of
            CLMT buffer used by this algorithm in 32-bit word units.
            This value should be chosen based on prior knowledge of
            maximum elements of each file entry would store.

    config FATFS_VFS_FSTAT_BLKSIZE
        int "Default block size"
        default 0
        help
            If set to 0, the 'newlib' library's default size (BLKSIZ) is used (128 B).
            If set to a non-zero value, the value is used as the block size.
            Default file buffer size is set to this value
            and the buffer is allocated when first attempt of reading/writing to a file is made.
            Increasing this value improves fread() speed, however the heap usage is increased as well.

            NOTE: The block size value is shared by all the filesystem functions
            accessing target media for given file descriptor!
            See 'Improving I/O performance' section of 'Maximizing Execution Speed' documentation page
            for more details.

    config FATFS_IMMEDIATE_FSYNC
        bool "Enable automatic f_sync"
        default n
        help
            Enables automatic calling of f_sync() to flush recent file changes after each call of vfs_fat_write(),
            vfs_fat_pwrite(), vfs_fat_link(), vfs_fat_truncate() and vfs_fat_ftruncate() functions.
            This feature improves file-consistency and size reporting accuracy for the FatFS,
            at a price on decreased performance due to frequent disk operations

    config FATFS_USE_LABEL
        bool "Use FATFS volume label"
        default n
        help
            Allows FATFS volume label to be specified using f_setlabel

    config FATFS_LINK_LOCK
        bool "Perform the whole link operation under lock"
        default y
        help
            If enabled, the whole link operation (including file copying) is performed under lock.
            This ensures that the link operation is atomic, but may cause performance for large files.
            It may create less fragmented file copy.
    config FATFS_USE_DYN_BUFFERS
        bool "Use dynamic buffers"
        depends on CONFIG_WL_SECTOR_SIZE_4096
        default y
        help
            If enabled, the buffers used by FATFS will be allocated separately from the rest of the structure.
            This option is useful when using multiple FATFS instances with different
            sector sizes, as the buffers will be allocated according to the sector size.
            If disabled, the greatest sector size will be used for all FATFS instances.
            (In most cases, this would be the sector size of Wear Levelling library)
            This might cause more memory to be used than necessary.
endmenu
```
